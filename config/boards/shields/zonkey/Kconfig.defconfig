## config/boards/shields/zonkey/Kconfig.defconfig
```kconfig
if SHIELD_ZONKEY_R

config ZMK_KEYBOARD_NAME
    default "zonkey"

config ZMK_BLE
    default y

config ZMK_SPLIT_ROLE_CENTRAL
    default y

config INPUT
    default y

config ZMK_POINTING
    default y

config SPI
    default y

config PMW3610
    default y

endif

if SHIELD_ZONKEY_R || SHIELD_ZONKEY_L

config NFCT_PINS_AS_GPIOS
    default y

config ZMK_SPLIT
    default y

config RGBLED_WIDGET_BATTERY_LEVEL_HIGH
    default 30

config RGBLED_WIDGET_BATTERY_LEVEL_CRITICAL
    default 10

endif
```
